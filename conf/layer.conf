## conf/layer.conf
```bitbake
# We have a conf and classes directory, add to BBPATH
BBPATH .= ":${LAYERDIR}"

# Add recipes to to BBFILES
BBFILES += " ${LAYERDIR}/recipes-*/*/*.bb "
BBFILES += " ${LAYERDIR}/recipes-*/*/*.bbappend* "

BBFILE_COLLECTIONS += "x-linux-qt"
BBFILE_PATTERN_x-linux-qt := "^${LAYERDIR}/"
BBFILE_PRIORITY_x-linux-qt = "7"

# This should only be incremented on significant changes that will
# cause compatibility issues with other layers
LAYERVERSION_x-linux-qt = "1"
LAYERSERIES_COMPAT_x-linux-qt = "kirkstone mickledore scarthgap"

LAYERDEPENDS_x-linux-qt  = "stm-st-stm32mp"
LAYERDEPENDS_x-linux-qt += "st-openstlinux"

# OpenSTLinux compatibility version
ST_OSTL_COMPATIBILITY_VERSION_stm-st-stm32mp = "5.1"

# =========================================================================
# QT development tools and framework version and license selection
# =========================================================================
# Default to opensource Qt 6.x version
QT_VERSION ?= "6.x"
QT_EDITION ?= "opensource"
```
